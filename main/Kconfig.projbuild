## main/Kconfig.projbuild
```kconfig
menu "Rigo Voice + Network"

config RIGO_WIFI_AP_SSID
    string "SoftAP SSID"
    default "rigo-box3"

config RIGO_WIFI_AP_PASSWORD
    string "SoftAP Password"
    default "rigoberto"

config RIGO_WIFI_STA_SSID
    string "Station Wi-Fi SSID"
    default ""

config RIGO_WIFI_STA_PASSWORD
    string "Station Wi-Fi Password"
    default ""

config RIGO_STT_URL
    string "Whisper STT endpoint (POST WAV, JSON response)"
    default ""

config RIGO_ASSISTANT_URL
    string "OpenClaw assistant endpoint (POST JSON)"
    default ""

config RIGO_TTS_URL
    string "TTS endpoint (POST JSON, WAV response)"
    default ""

config RIGO_API_BEARER
    string "Bearer token for cloud APIs"
    default ""

config RIGO_CAPTURE_MS
    int "Post-wake capture window (ms)"
    default 3500
    range 1000 10000

endmenu
```

## sdkconfig.defaults
```kconfig
# Non-secret defaults (safe to commit)
CONFIG_PARTITION_TABLE_CUSTOM=y
# CONFIG_PARTITION_TABLE_SINGLE_APP is not set
# CONFIG_PARTITION_TABLE_SINGLE_APP_LARGE is not set
CONFIG_PARTITION_TABLE_FILENAME="partitions_rigo.csv"

CONFIG_LV_BUILD_EXAMPLES=n
CONFIG_LV_BUILD_DEMOS=n

CONFIG_ESPTOOLPY_FLASHSIZE_16MB=y
# CONFIG_ESPTOOLPY_FLASHSIZE_2MB is not set

CONFIG_RIGO_WIFI_AP_SSID="rigo-box3"
CONFIG_RIGO_WIFI_AP_PASSWORD="rigoberto"
CONFIG_RIGO_WIFI_STA_SSID=""
CONFIG_RIGO_WIFI_STA_PASSWORD=""

# ESP-SR model selection (built-in wake word)
CONFIG_SR_WN_WN9S_HIESP=y
# CONFIG_SR_WN_WN9_HIESP is not set
CONFIG_MODEL_IN_FLASH=y
# CONFIG_MODEL_IN_SDCARD is not set

# Voice cloud endpoints (set real values in sdkconfig.defaults.local)
CONFIG_RIGO_STT_URL=""
CONFIG_RIGO_ASSISTANT_URL=""
CONFIG_RIGO_TTS_URL=""
CONFIG_RIGO_API_BEARER=""
CONFIG_RIGO_CAPTURE_MS=3500
```

## sdkconfig.defaults.local.example
```kconfig
# Copy this file to sdkconfig.defaults.local and fill with your real Wi-Fi.
# This file is ignored by git.

CONFIG_RIGO_WIFI_STA_SSID="YOUR_WIFI_SSID"
CONFIG_RIGO_WIFI_STA_PASSWORD="YOUR_WIFI_PASSWORD"
```
